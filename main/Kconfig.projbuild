## main/Kconfig.projbuild
```kconfig
config LILYGO_T_DISPLAY_S3
    bool
    default y

menu "TCP Client"

    config TCP_CLIENT_SERVER_IP
        string "Server IPv4 address"
        default "127.0.0.1"
        help
            IPv4 address of the TCP server to connect to.

    config TCP_CLIENT_SERVER_PORT
        int "Server port"
        range 1 65535
        default 5555

    config TCP_CLIENT_USERNAME
        string "Username"
        default "admin"

    config TCP_CLIENT_PASSWORD
        string "Password"
        default "admin"

endmenu
```

## sdkconfig.defaults
```kconfig
CONFIG_LILYGO_T_DISPLAY_S3=y
CONFIG_IDF_TARGET="esp32s3"
CONFIG_IDF_TARGET_ESP32S3=y
CONFIG_SPIRAM=y
CONFIG_SPIRAM_MODE_OCT=y
CONFIG_SPIRAM_TYPE_AUTO=y
CONFIG_ESP_CONSOLE_USB_SERIAL_JTAG=y
CONFIG_ESP_DEFAULT_CPU_FREQ_MHZ_240=y
CONFIG_ESP_DEFAULT_CPU_FREQ_MHZ=240
CONFIG_ESPTOOLPY_FLASHSIZE_16MB=y
```
